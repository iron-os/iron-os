## buildroot/board/common-headless/package/Config.in
```kconfig
source "$BR2_EXTERNAL_IRON_OS_PATH/service-bootloader/Config.in"
source "$BR2_EXTERNAL_IRON_OS_PATH/noto-emoji/Config.in"
```

## buildroot/board/common-headless/package/service-bootloader/Config.in
```kconfig
config BR2_PACKAGE_SERVICE_BOOTLOADER
	bool "service-bootloader"
	depends on BR2_PACKAGE_HOST_RUSTC_TARGET_ARCH_SUPPORTS
	select BR2_PACKAGE_HOST_RUSTC

if BR2_PACKAGE_SERVICE_BOOTLOADER

config BR2_PACKAGE_SERVICE_BOOTLOADER_HEADLESS
	bool "headless (no ui)"

endif
```
